#ifndef AI_DETECT
#define AI_DETECT

#include <stdint.h>
#include <TensorFlowLite.h>
#include <tensorflow/lite/micro/all_ops_resolver.h>
#include <tensorflow/lite/micro/micro_error_reporter.h>
#include <tensorflow/lite/micro/micro_interpreter.h>
#include <tensorflow/lite/schema/schema_generated.h>
#include <Arduino.h>

#define IDLE 1
#define EATING 0
#define WALKING 2


#define NUM_SAMPLES 60
#define NUM_GESTURES 3


void ai_init();
uint8_t ai_detect(float aX, float aY, float aZ);


extern "C" void DebugLog(const char* s) {
    Serial.println(s);
}

namespace test_over_serial {
    void SerialWrite(const char* s) {
        Serial.print(s);
    }

    char* SerialReadLine(int timeout) {
        static char buffer[100];
        int index = 0;
        unsigned long startTime = millis();
        
        while (millis() - startTime < timeout) {
            if (Serial.available()) {
                char c = Serial.read();
                if (c == '\n' || c == '\r') {
                    buffer[index] = '\0';
                    return buffer;
                } else if (index < sizeof(buffer) - 1) {
                    buffer[index++] = c;
                }
            }
        }
        return nullptr;
    }
}



tflite::MicroErrorReporter tflErrorReporter;
tflite::AllOpsResolver tflOpsResolver;

const tflite::Model *tflModel = nullptr;
tflite::MicroInterpreter *tflInterpreter = nullptr;
TfLiteTensor *tflInputTensor = nullptr;
TfLiteTensor *tflOutputTensor = nullptr;

constexpr int tensorArenaSize = 64 * 1024;
byte tensorArena[tensorArenaSize] __attribute__((aligned(16)));

const char *GESTURES[NUM_GESTURES] = {
    "Eating",
    "Idle",
    "Walking"};

uint8_t ai_state = 1; 
static int sampleIndex = 0;

void ai_init()
{
    tflModel = tflite::GetModel(model);
    if (tflModel->version() != TFLITE_SCHEMA_VERSION)
    {
        Serial.println("Model schema mismatch!");
        while (1);
    }

    tflInterpreter = new tflite::MicroInterpreter(tflModel, tflOpsResolver, tensorArena, tensorArenaSize, &tflErrorReporter);
    tflInterpreter->AllocateTensors();

    tflInputTensor = tflInterpreter->input(0);
    tflOutputTensor = tflInterpreter->output(0);
}

uint8_t ai_detect(float aX, float aY, float aZ)
{
    // Nếu buffer chưa đầy, cứ thêm dữ liệu vào
    if (sampleIndex < NUM_SAMPLES) {
        tflInputTensor->data.f[sampleIndex * 3 + 0] = aX;
        tflInputTensor->data.f[sampleIndex * 3 + 1] = aY;
        tflInputTensor->data.f[sampleIndex * 3 + 2] = aZ;
        sampleIndex++;
        return ai_state;  // Chưa đủ dữ liệu, chưa dự đoán
    }

    // Buffer đầy, thực hiện dịch dữ liệu (sliding window)
    for (int i = 1; i < NUM_SAMPLES; i++) {
        tflInputTensor->data.f[(i - 1) * 3 + 0] = tflInputTensor->data.f[i * 3 + 0];
        tflInputTensor->data.f[(i - 1) * 3 + 1] = tflInputTensor->data.f[i * 3 + 1];
        tflInputTensor->data.f[(i - 1) * 3 + 2] = tflInputTensor->data.f[i * 3 + 2];
    }

    // Thêm mẫu mới vào cuối buffer
    tflInputTensor->data.f[(NUM_SAMPLES - 1) * 3 + 0] = aX;
    tflInputTensor->data.f[(NUM_SAMPLES - 1) * 3 + 1] = aY;
    tflInputTensor->data.f[(NUM_SAMPLES - 1) * 3 + 2] = aZ;

    // Chạy mô hình sau mỗi bước dịch
    if (tflInterpreter->Invoke() != kTfLiteOk)
    {
        Serial.println("Invoke failed!");
        return ai_state;
    }

    // Tìm nhãn có xác suất cao nhất
    int maxIndex = 0;
    float maxValue = tflOutputTensor->data.f[0];

    for (int i = 1; i < NUM_GESTURES; i++)
    {
        if (tflOutputTensor->data.f[i] > maxValue)
        {
            maxValue = tflOutputTensor->data.f[i];
            maxIndex = i;
        }
    }

    Serial.print("Detected: ");
    Serial.println(GESTURES[maxIndex]);

    ai_state = maxIndex;

    return ai_state;
}

const unsigned char model[] = {
  0x1c, 0x00, 0x00, 0x00, 0x54, 0x46, 0x4c, 0x33, 0x14, 0x00, 0x20, 0x00,
  0x1c, 0x00, 0x18, 0x00, 0x14, 0x00, 0x10, 0x00, 0x0c, 0x00, 0x00, 0x00,
  0x08, 0x00, 0x04, 0x00, 0x14, 0x00, 0x00, 0x00, 0x1c, 0x00, 0x00, 0x00,
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  0x0c, 0x00, 0x00, 0x00, 0x46, 0x00, 0x00, 0x00, 0x00, 0x00, 0x00, 0x46
};
#endif